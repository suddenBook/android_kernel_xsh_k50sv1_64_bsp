## drivers/input/touchscreen/mediatek/focaltech_touch_ft8057/Kconfig
```kconfig
config TOUCHSCREEN_MTK_FOCALTECH_FT8057
	bool "FocalTech FT8057 touchscreen for k50sv1"
	depends on TOUCHSCREEN_MTK=y && I2C=y && MTK_LCM=y
	select K50_LCM_BIAS
	default n
	help
	  Build the source candidate for the FT8057 controller fitted to the
	  k50sv1_64_bsp.  This driver intentionally omits firmware flashing,
	  factory tests, gestures, proximity and automatic ESD recovery.
```

## drivers/misc/mediatek/dramc/Kconfig
```kconfig
config MTK_DRAMC
	tristate "MediaTek DRAMC driver"
	default n
	---help---
	  This selects the MediaTek(R) DRAMC driver.

config K50SV1_STOCK_DRAM_HPM
	bool "K50SV1 stock-preloader HPM data rate"
	depends on MTK_DRAMC && MTK_PLATFORM = "mt6755"
	default n
	help
	  The stock K50SV1 preloader configures HPM DRAM for DDR-1666,
	  reported as 1664 by this driver's register calculation, while
	  the SoC segment selects the 1796 rate table. Select the existing
	  1664 HPM expected rate for this board. The LPM expectation,
	  measured rate and PLL/voltage programming remain unchanged;
	  SPM continues to validate the measured rate.
	  The bandwidth governor also uses this rate to normalize thresholds.

config MTK_DRAMC_PASR
	bool "Mediatek DRAMC PASR control"
	default n
	help
	  Mediatek(R) PASR HW control.
	  This controls the setting of DRAM mode register
	  for PASR(Partial Array Self-Refresh).
	  Caller needs to prepare bit-mask setting of DRAM
	  segment to trigger PASR.

config MTK_COMMON_EMI
	bool "Common emi driver for 8127/2701/7623"
	help
	  This enable 8127/7623/2701 common emi driver.
```

## drivers/misc/mediatek/gpiokey/Kconfig
```kconfig
config MTK_GPIO_HALL
	bool
	depends on TOUCHSCREEN_MTK_FOCALTECH_FT8057=y
	default y
	help
	  Build the GPIO7 Hall/stylus path fitted to k50sv1_64_bsp.  This is
	  an exact built-in pair with the FT8057 touchscreen and is unrelated
	  to the generic MediaTek hallsensor driver.
```

## drivers/misc/mediatek/imgsensor/Kconfig
```kconfig
config MTK_IMGSENSOR
	tristate "enable MTK cam driver"
	default n
	help
	  It support different sensor.
          If this option is set to m,
          it will build module.

config MTK_CAM_MAX_NUMBER_OF_CAMERA
	int "max number of camera supported"
	default 2
	help
	  max number of camera supported

config MTK_EFUSE_DOWNGRADE
	bool "a variant of downgrade chip"
	default n
	help
	  a variant of downgrade chip

config K50SV1_STOCK_SENSOR_LIST
	bool "k50sv1_64_bsp stock sensor-list layout"
	depends on MTK_IMGSENSOR
	default n
	help
	  Lay out kdSensorList[] exactly like the shipped k50sv1_64_bsp
	  kernel: ten entries in the stock order with the stock ids and
	  names.  The camera HAL searches sensors by index into this table,
	  so the two fitted drivers (IMX145, GC5025) must sit at indices 1
	  and 6; the other eight entries bind to a placeholder that reports
	  no sensor.
```

## drivers/misc/mediatek/lcm/Kconfig
```kconfig
config MTK_LCM
	bool CONFIG_MTK_LCM
	default n
	help
	  LCM driver

config K50_LCM_BIAS
	bool
	depends on MTK_LCM
	help
	  Build the k50sv1 ENP/ENN/ENP2 pinctrl provider. This hidden option
	  is selected by board consumers that require the shared bias rails.

config CUSTOM_KERNEL_LCM
	string "CUSTOM_KERNEL_LCM"
	help
	  To choose kernel LCM driver name

config MTK_LCM_DEVICE_TREE_SUPPORT
	bool "MTK_LCM_DEVICE_TREE_SUPPORT"
	help
	  Decide whether to support LCM device tree based configuration.
	  This feature requires the connection between display driver and LCM devices.
	  Please also turn on MTK_LCM_DEVICE_TREE_SUPPORT in ProjectConfig.mk.
```

## drivers/misc/mediatek/sensors-1.0/accelerometer/mir3da/Kconfig
```kconfig
config MTK_MIR3DA
	bool "MiraMEMS MIR3DA accelerometer"
	depends on CUSTOM_KERNEL_ACCELEROMETER
	depends on I2C=y
	depends on MTK_SENSORS_1_0
	default n
	help
	  MiraMEMS NSA-family accelerometer (DA380 class, WHO_AM_I 0x13) on the
	  MediaTek sensors-1.0 framework, the vendor reference driver.  It
	  binds the mediatek,gsensor_mir3da node; on k50sv1_64_bsp that node
	  says 0x26 while the part answers at 0x27, which the driver's probe
	  handles the way the shipped kernel does.
```

## drivers/misc/mediatek/wusb3801x/Kconfig
```kconfig
config USB_CC_WUSB3801X
	bool "WUSB3801X Type-C configuration-channel controller"
	depends on I2C=y && MTK_ACCDET
	default n
	---help---
	  WillSemi WUSB3801X CC-logic controller on the k50sv1_64_bsp USB-C
	  port.  It detects the attached partner, advertises host current,
	  and on an audio accessory routes the analog switch and hands the
	  headset to ACCDET.  Host mode itself is owned by the MediaTek USB
	  controller's ID-pin path.
```
